## packages/esp-idf/Kconfig
```kconfig
# QRKude - ESP-IDF configuration
# Copyright 2026 The QRKude Authors
# SPDX-License-Identifier: Apache-2.0

menu "QRKude (styled QR codes)"

    config QRKUDE_MAX_VERSION
        int "Largest QR code version"
        range 1 40
        default 40
        help
            Size of qrk_code: version 40 (177x177 modules) needs 3922 bytes,
            version 10 (57x57) 412 bytes. The encoder scratch buffer has the
            same size. Lower it to save RAM when the payloads are short
            (version 10 holds up to 213 bytes at ECC M).

    config QRKUDE_NO_MALLOC
        bool "Never allocate memory in the core"
        default n
        help
            qrk_encode() then requires a scratch buffer (a NULL scratch
            buffer returns QRK_ERR_INVALID_ARGUMENT instead of calling
            malloc). The LVGL widget still uses the LVGL allocator.

    config QRKUDE_OPTIMIZE_SPEED
        bool "Compile QRKude with -O2"
        default y
        help
            The rasterizer evaluates the shape model per sample; -O2 makes it
            noticeably faster than -Os at a cost of a few KB of flash.

endmenu
```

## packages/esp-idf/examples/basic/main/Kconfig.projbuild
```kconfig
# QRKude ESP-IDF example configuration
# Copyright 2026 The QRKude Authors
# SPDX-License-Identifier: Apache-2.0

menu "QRKude example"

    config EXAMPLE_LCD
        bool "Draw the QR code on an ST7789 SPI LCD (esp_lcd)"
        default n
        help
            Without an LCD the example only prints to the console.

    if EXAMPLE_LCD
        config EXAMPLE_LCD_H_RES
            int "Horizontal resolution"
            default 240
        config EXAMPLE_LCD_V_RES
            int "Vertical resolution"
            default 240
        config EXAMPLE_LCD_PIN_SCLK
            int "SCLK GPIO"
            default 18
        config EXAMPLE_LCD_PIN_MOSI
            int "MOSI GPIO"
            default 23
        config EXAMPLE_LCD_PIN_CS
            int "CS GPIO"
            default 5
        config EXAMPLE_LCD_PIN_DC
            int "DC GPIO"
            default 16
        config EXAMPLE_LCD_PIN_RST
            int "Reset GPIO (-1 = not connected)"
            default 17
        config EXAMPLE_LCD_PIN_BL
            int "Backlight GPIO (-1 = not connected)"
            default 4
        config EXAMPLE_LCD_INVERT
            bool "Invert colors (most IPS ST7789 modules need it)"
            default y
    endif

endmenu
```
